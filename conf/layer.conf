## conf/layer.conf
```bitbake
# We have a conf and classes directory, add to BBPATH
BBPATH .= ":${LAYERDIR}"

# We have recipes-* directories, add to BBFILES
BBFILES += "${LAYERDIR}/recipes-*/*/*.bb \
            ${LAYERDIR}/recipes-*/*/*.bbappend"

BBFILE_COLLECTIONS += "meta-raspberrypi-rt"
BBFILE_PATTERN_meta-raspberrypi-rt = "^${LAYERDIR}/"
BBFILE_PRIORITY_meta-raspberrypi-rt = "10"

LAYERDEPENDS_meta-raspberrypi-rt = "core"
LAYERSERIES_COMPAT_meta-raspberrypi-rt = "kirkstone"

LAYERVERSION_meta-raspberrypi-rt = "1"

MACHINEOVERRIDES:append = ":raspberrypi4-64-rt"
```

## conf/machine/raspberrypi4-64-rt.conf
```bitbake
# Recuperer la configuration initiale pour la raspberrypi4-64
require conf/machine/raspberrypi4-64.conf

# Ajout des configurations specifiques RT
require conf/machine/include/raspberrypi4-64-rt.inc


PREFERRED_PROVIDER_virtual/kernel = "linux-raspberrypi"
PREFERRED_VERSION_linux-raspberrypi = "5.15%"
```
